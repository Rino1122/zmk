## app/dts/bindings/behaviors/zmk,behavior-ptp-mode.yaml
```yaml
description: Per-host Precision Touchpad compatibility mode (changed policy restarts central)
compatible: "zmk,behavior-ptp-mode"
include: one_param.yaml
```
